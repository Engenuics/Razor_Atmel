/**********************************************************************************************************************
File: mpgl1_audio_test.c                                                                

Description:
Tests the buzzers on the MPG Level 1 Atmel MPG board.
**********************************************************************************************************************/

#include "configuration.h"

/***********************************************************************************************************************
Global variable definitions with scope across entire project.
All Global variable names shall start with "G_<type>AudioTest"
***********************************************************************************************************************/
/* New variables */
volatile fnCode_type G_AudioTestStateMachine;           /* The state machine function pointer */
volatile u32 G_u32AudioTestFlags;                       /* Global state flags */


/*--------------------------------------------------------------------------------------------------------------------*/
/* Existing variables (defined in other files -- should all contain the "extern" keyword) */
extern volatile u32 G_u32SystemFlags;                  /* From main.c */
extern volatile u32 G_u32ApplicationFlags;             /* From main.c */

extern volatile u32 G_u32SystemTime1ms;                /* From board-specific source file */
extern volatile u32 G_u32SystemTime1s;                 /* From board-specific source file */


/***********************************************************************************************************************
Global variable definitions with scope limited to this local application.
Variable names shall start with "AudioTest_" and be declared as static.
***********************************************************************************************************************/

static u32 AudioTest_u32Timeout;                      /* Timeout counter used across states */
static u32 Print_u32Timeout;                          /* Timeout counter used in print timeout */
static u32 AudioTest_u32Position;
static u32 AudioTest_u32Delay;
u8 * AudioTest_song;

/***********************************************************************************************************************
Global constant definitions with scope limited to this local application.
Constant names shall start with "AudioTest_" and be declared as const.
***********************************************************************************************************************/

u8 au8AudioTest_LetItGoArt1[] ="..................,,.,?MMM=,MM  .....   ......,.................................\n\r\r...................MM$. .MM.,:MMMMMNDMMMMMMMMM+.................................\n\r\r................=MM,.:.MMM$MM$ ,.ZM? .. . ....~MMM,.:...........................\n\r\r...........,..8M:,,.,M~MMM.. .M~. . .  . ..,.....,.NM~:.........................\n\r\r....... ...MMNM:.,.M..MM , .7~............... ..    .MN?., .....................\n\r\r....... ?M$MM .. .= .,. , + ..,.............    .... .,.M=. ....................\n\r\r.....+.M7.$Z .  =    =...  ............,..~DM?:.   .:8M$ MM... .................\n\r\r...N,OM. MM...,$  .+.. .:............,+O..$MM+:......ZMMI MN .,.................\n\r\r,.M7M. ,8M  . +. ..................,:.DM~..................DMM. .. .............\n\r\r NZM .,.M.. ,. . .$............,....MD.......................MM  , .............\n\r\rOM+,, ?OM. ..:.,.?.. .............O.........................,.:M.M,.............\n\r\rM 7 .O MI...~    $7...........,.M,..............................M:N+,,..........\n\r\rM .,Z,DM=.. :... .,  .........M..:...............................IO ~ ..........\n\r\rM. .: ~M?  .  ...............N .... .....,~??I?~....................M ..........\n\r\rM .N +.DM,.?...............::....... $.IMN8NM$~..  .,$~ ........... ~M..........\n\r\rM .+.7.:M..7..,..,.........,. .. .,,M:....,,   . 7M:,.  :?.......... M..........\n\r\rIM ,.+. M7.7 ....+=......,...... : ,MM .. . ...=M8  ..O7.,..:O:  ....M..........\n\r\r,IM=:.? .M..I:...=$....  +.?M7.:MMMNMM....... .....7M... .N:..... .,M=.M........\n\r\r .88:.I :IM M,........... M..: ,   .  MN~7MD.  ....,.IM$.., :D. ... M.$?........\n\r\r., MM..M .~D.8....:.,... M,+.. Z+. ...~ M?NO. N:.,....,.:MO. ... +MZNM.$........\n\r\r...,$M .I..MN?~....?. . M.   .=MN8MM ,.Z7.. D:. :...,...., $MMMMMMMO ,.M........\n\r\r... ..M7 .=, M8....,+. .M,  .?. ...,.M  =~ :,:M=.:.7.....  ..  . . .,.M=........\n\r\r.......DM,.:+DIM,.~.~?D M.::I......  .O.~......MM. ..O... . . . ...,,MO.........\n\r\r....... N.M.~$. IM  $ ~7. .........   M.M.......+N?. , ..MI. ... ~M?DM..........\n\r\r.......M =Z,N~.... .,...... ...,.... .Z7O........Z MN ,   .. . .. : N...........\n\r\r.......M.M.MM....,  .... ...........OMMMD,.,..... D,.M:  . .., ...8M ...........\n\r\r.......M.M. M ............... ...,NM..M. .... ..  ??.. =M ..M  ,, M  ...........\n\r\r.......~N?Z M .............. :, MM ,, ";
u8 au8AudioTest_LetItGoArt2[] =" :, . ., .., Z~.ON. ,$,M,.MM... ..........\n\r\r..........DDM,.............. INM.. $,,DMNMMMMMM$.,.8: + .8,..OMZ .MM, ..........\n\r\r.........., 8MN~I8MMMI.,.,.ZMM    I.MMD+ NN~DM~....7.8..?, , 8M.N  M$...........\n\r\r..........  ,M,,  .. .:.,...... :MNMNMMMM. MMM .  .+:M 7. M .MM+ M  MN..........\n\r\r.............?N,~ ,M.   ........  M,NMMMM?.MO..... :+M.7,,$ =M=M. M.,MM.........\n\r\r.........,ZNMNMNNMMMM: .........IMM  MMMM,N8,.... . ?ON  ?. M .7I..8 .OM........\n\r\r............=.~~ .+=MMM  ,. ....?N IM:.~O~.,.........:Z..,:M ,..M8.,? .7$.......\n\r\r.............. M. N.MNMM ......  :. :+MZ+............+I..,M$ ...,M8,....M.......\n\r\r.............. MM..:.?MN$.,...........................,7.M M ......M.,  NM   ...\n\r\r...............IM8MDMMN$...............................MMZ.. .......I.:.,M. ....\n\r\r..............  O+.  .................................=M..M.N,......:N ..M7.....\n\r\r................:M   ......+..........................MM=..M.7 ......=7  MD.....\n\r\r............... .8Z.....,.7..........................MN?M...D,=........$ MM.....\n\r\r..................M.,.. .=~   .  . ......,........  8,N $M ,,N~,. .....,.DM.....\n\r\r...................M:. .,M.. ~?:. .....=.,.......  MZ.MM~OM$. ,M.  ... .N8D.....\n\r\r.................,..MN.      .. ..,IDM........:..MM..MD~:7 ~MM+.I=.,, ..+MZ.....\n\r\r....................,,M ,  ..:?O8:+=M.........,,M .:, ..+M.. 7MMNZ?. .   MM,,...\n\r\r.......................IMZ,..7?= .N..........?M=........~M ....,O.NMMM=. 8$M ...\n\r\r........................,7M+.,ZM8. ........:N8,......... M....., M,.7,MM.=ON ...\n\r\r.........................,..MM ... ......~NO....,....... M. ......+: M .ZMM.M...\n\r\r..............................M ., ..:.,MZ.,.............M= .......:  N .,M,MD..\n\r\r................................MM~~OMMOM................DM........:Z ,Z. N, M+.\n\r\r...............................,........M .............. NMM . ....,.:.N. ~D.?M.\n\r\r.................................... ...M................M.M ........, : .,M..M,\n\r\r.......................................~M ......~+:.....O, .M$ ..,......,. M..M$\n\r\r.......................................MD+MMM?,.........M. .DMN.........:. M..M8\n\r\r......................................MM?..............=M,.+ M:M+ ,..  .:..M,,MI\n\r\r....................................8N.................$M..M+8  MM ., ..,..M .N.\n\r\r.................................,7M:....,.............7M  M7.....MM.  .  .M MZ \n\r\r................................,.M.,..................=M..M?..  , 8:   ..:OZM..\n\r\n\r===============================================\n\r";
u8 au8AudioTest_gameOfThronesArt[] =",NDNDMNND8NNDNN$N8D8DNDNNNNNNNNNNNNNNNNNNNNNNNNNNNN8NNDNMNNNNMNMNMMNNDNNM8=DMNNN\n\rN78NDNZNNDMDDNDNNDNNDNNNNNNNNNNZNNNNNNNNNNNNNNNNNNNNNNMNNNN7NNNNNNDDMNNNDDDN8NND\n\rNNMO8DND888NNN88DNNNNNDNN$NNNNNNNNNNNNNNNNDNNMNNNNNNNNDNNNNNNNNNNNMNNNDMDNNNNNDN\n\rDDNNDDNDNMNNM?DNNNNNDN8D8NNNNNNNDNN8NNN.MNNNN .  .MNNNNNNNNDMN?NDNNND8NNDMDNOD$N\n\r7DM7DNDNND8NDNDNNZN8DN8DDNNNNNMNNNNN,. ..:...    .....NNNNMNZDNNDNDN8DNDNNNDDNDD\n\rNDMMDDNDDNONN8DDDDNNDNNMDNNN8NMND+..~..... . .....NN  .......NNDNNNNNMNMMNNDNNDN\n\rNNNNODNDDNDNNMNNNND8NNNNNDNDDNNNN8  Z:~, : =. .:... =.D  ...NNNNNNNNDNNDNNNN8NND\n\r8NNNNODNNODNNNNNNNNNDNNNNNDDMNN~...,.  ..... ...,..,.,   ..NNNDNNNNNNNNNNNNN8NND\n\rNNNNDDDNDNNNNDNNDNNDDDDDNMN.,...MM.D:...M $$N... N.?  ....NMNNNNNNNNNNMNNNNONNDO\n\rNNNNNNDNDNDNNNNDNNNNNNZ.MNNN?.,. :.N... N.7 NN  .NMNNNNNODONNNNNDNDNNDNDNNNDNNND\n\rNNDMNNN8NNNNNNNNNNNN8NMON.... ...  .....,....,..... ,..MNNNDNNNNNONNDDDDDNMNNNNN\n\rNONNNND8NNNNNNNNNNDNNNN. ...:..~.N...NM~D=M~N:N.   ...:DNNNNNNNNNNNMNMDNNNNDNNND\n\rMNNNDNNNDNDNNDNNNND8NND8NNN.. .. ...  .,.+,...,.NMNN.. 8NNNNNNNNNNNNNNN8MND8NMNN\n\rNOMDNNNDNNNNNNNNNNDDNNNNNNNMN..,.....,.. ?. ...NNNNDN.NNNNNNDNNDNNNNNNN88DMDONNN\n\rNNNDNDDDNNONNNNNNDNNNNNNDNNNN O... . . .    =..NNNNDNNNDNNNDNND8NNNNNDMNONDNDNN8\n\rNDNNNNO8DD8NNNNNNNNNNNNNNNNNNNN8...?N...... .NNNNNNNNNN8NNNDDDNNNDNNNDMNNN8NMNOD\n\rNNDNNNNNDNMNNNMDNNNNN8NNNNNNNN..... ..  ...N.NNNNNNNNNNNN8NNN8NNNNDDDNDDDNNNN8DD\n\rNNNDMNNNNNNNNNNNNNNNNNNNN$NNNNN. ...N..+..NNNNNNNDNNNNNNNNNMNNMNNND8NDNDDDDNNDND\n\rNNNN8DDNNNNDNNNNNNNNNNNNNNDNNN . ... .....DNNNNNNNNNNNNNNNNNNNNNNNNNNNONNNNNDMNN\n\rNMNNND88NNNNNNNNNNNNNNNNNNNNNNNN.. . =  .NDNNNNNNNDNNNNDNNNDNDNNDNNNNNNNMN?MNNND\n\rNNDNDNNNNNNNNNNNNDDMNNNNNNNNNNN7.. .,...NNNDNNNNNNNNNNNNNDNDNNNNNNNNDNDDNDNNNNNN\n\rNMNNNNDNNNNNDNNNNNNNNDNNNNNNNNNNNN..N. .NNNNMNNNNMNNNNNNNNNNNNMNNNDNDNNNNND8NNNN\n\rNNNDDNNNMNNNNNNNNNDNNNNDMNNNNNNNNNNNN.?NNNNNNNNNNNNNNNNNNNMNZD8NNNNNNNOD8NDONNNN\n\rNNNNNNNNNDNNNMNNNNNNNNNNNNNNNNNNNNNNN.NNNNNNNNNNNNNNNNNND8NDDNNNNNMNDDDDNDNNDDNN\n\rNNNNNNDNNNNNN8ONNNNDMNNNNNNMNNNNNNNNN.NNNNNNNNNNNNNNNNNNNMD8ONNNNNDDDNDNNDNNNNDD\n\rNNN8MNDNNNNDMD:MNNNNNNNNNNNNNNNNNNNNNNNNNNNNNNNNNNNNNNNNNNNNNNNNNNDNDNNNNDNDNNNN\n\rOMNNNNNNN8NN8NN8NNNNNNNNNDMNNNNNNNNNNNNNDNNNNNNNNNNNNNNNNNNNNNNN8NNNN8NDDNDNNMND\n\rNDDDNOD8MNNNNDMNNNNNNNNNNNNNDNNNDNNNNNNNNNNNNNNNNNNNMNNNNDNNNNNODDNNNNONNNNNDNNN\n\rNNNNMNN8NN8NND8M8DNNDNDDNNNNDNNNNNNNNNNNNNNNNNNDNNNNNNNONMNNNNDDNDNNDNNNNNNNNDMN\n\r\n\r===============================================\n\r";
u8 au8AudioTest_passengerArt[] ="\n\rNNNNNNNNNNNNNNNNNNNNNNNNNNNNNNNNNNNNNNNNMNNMMNNNNMMMNMMNNNNNNNNMNNNNNNMMNNNNNNNN\n\rZZOOZZZ$$7777I77$$7$$$$$$$777$$7$OOOZONNOZZOZOOOOOOOOOO8OOZOZOZZOOZOZZOZZOO8Z8NN\n\rNM8NDDNNNNNMNNNNNDDNMMMNMNNMNNNNNNNNN8NM8ND8DDDDNNNNNNNNNNNNNNNNNNNNNNNNNNDDO8NN\n\rMNNNDO8OOMN8888DNNNNNNMNNNNNNNNNMMNMM8NNOND88888DDNNNNNNNNDDDNDDDD8DDDDDDNDDO8ND\n\rNNNNDZOZ$ZZZ$77??I$$ZZ$ZZOZ$$ZO88O8DN8NMZD8OZ$Z$ZOO8ZOZZO88ZOZZOOO8OOO88DDN88DND\n\rNDNNDMNNNNNN:...,?I8ZOOOO88O8DD8$ND8N8NNZDD8888D88DDDDDDDDDDDDDDDDDD888OO8MDODND\n\rNDDN8NNNNNNDZO$??IOZZ$OOO8888888888DN8NN$DD888D88888DDD888DDDDDD88888O88ODN88DN8\n\rNDDN8NNDDD88DOOOZZ$$$ZOO8ZZOOOOO88O8N8NNZDND888888DDDD888O8D88888O8888OOO8MDDNN8\n\rNDNNONNND8OOZ$$ZZ$$ZOD88OZOZZOOOOO8ONZNN$DN88888O8888888D888OO88OOOOO8OO88NDDNNO\n\rNDNNONDDDN8O888DD8DDDDOOOOOOOOO8888DNZMN$NN8D88888D888888OOOOOO87$$ZZ8OO8DNNNNNO\n\rN8DN8DDDD8D8DDDDDD88O8OOZOOZOOOOOOODNZNN$NN88O8OOOOOOOOOO88OOOZ$777ZO8O8ODDNMMN8\n\rN8DM8NNNDDDDD8888DOZZO888OOOOZOZOOO8D8NN$NND8OZZZZ$ZZZZZZZOOOO8$$+777O888DDMNNN8\n\rNDDNDNNDDDDD88OOD8D88888OOOOZOOZZZZDDONN$NND8ZZ$$$$ZZZZZZ$Z$ZZZ$777$$OO88DNNNNN8\n\rNDDNDNDD8OOOOO888OOOOOOOOZZOZOZZZOODN8NN$NND+Z$$$Z$$$$Z$$ZZZZZZZ$7$ZOOOO8DNMNMN8\n\rM8DDNDOOZZ$$ZZZZZZZOOOOOOZZZZOOOZOO8NONN$N88OZ7Z$Z$$$7777I77Z$ZZZ$I$ZZZZZDDMNDNO\n\rNN8DNZZZ77$$I$Z$ZZ8OOOOOOOOOOOOZOOZON8NN7N8ZZ8ZZOZ$$$I?I=???7$$$7777777$$8DMNNN8\n\rND8DN7$$$77$$MNDMMMM88OOOZOO8OOZZZ$ZNDNN7N8$$ZZZOZ$$$I7I????I$777IIIII77$8DNNNNN\n\rNDDN8$7II7I77MMMMMMMMMDMDMNDMNZZ$7I$N8NN$N87Z77Z$Z$$$$7????++I7?I????I7$7D8NNNNN\n\rNNNN8II7I$ZMMMMMMMMMNMMMMNMMMMNOZI7$NZNN7DD87777I7II77$7II7II?IIII?III77IDNNNDNN\n\rMNNNNI7ONMMNMNMMMMMMMMMMMMMMNNNNNNDZNONNIDN7III7$7I7I7I7I?$$$77IIIII?I?I?DNNNNN8\n\rMNNNN$NNMNNNMNMNMMMNMNMNNMMNMNNNMD88NONNIN87I??$II77I77IIZ$7I$I7?II?I???+DMNNDNN\n\rMNNNNM7.NINMM:NN.MMDMNM..N~MNNNND7=8NZNNZNDN+I+?+? IIII.?7.I7..IZ7I???:=+DDNNDNN\n\rMDNNNM:MN..NNM=MD.NNMNM:.N~ONNNN8.88N8NNZNDDI?I==?.++??,+$:II.??II?=+?~?+DNND8NN\n\rNNNNNNN8ZZZOOOZZ$$OO8OO888OZO8ZO8ZZ8NDNNZNMMO$7?+:+=,.I$8OOZ$?7??????7$I?8ND88NN\n\rM8NNNMNNNNNNMMMMNNNNNNNNNNNMMMMMMMNMMMMMMNNNNMNNMMNMNNNNN88NNNNDOOOOOOOOODN8DDNM\n\rMNDDNNDDDDD88DDDD8DNDDNDNNNNMMD8DNNNNNMMNNNMNNMMNMNMNMMNMMMNNDDDNDD88DDNDNNNN8NM\n\rMDDDNNNNNNNNNNNNNNNNNNNNNNNNNNNNNDNNMDNMDN88O8888OOOOO88?+++?8+Z?====+=++8NNDDNN\n\rNDDDDNNNNNNNNNNNNNNNNNNNNNNNNNNNNNNNMONNOD88Z$O888888DDDDDDZ+88$+=====+8MDMDD8NN\n\rMDDDDMNNNNNNNNNNNNNNNNNNNNNNNNNNNNNNMDMM8D88.:$DDDDNNNNNNNNNNNNZNNDNNNNMNNNDDDNN\n\rMNNNNNNNNNNNNNNNNNNNNNNNNNNNNNNNNNNNMDMMNNDN,:8NND?8NNNNNNNNNNNNNNNNNNNNNNNDDDNN\n\rMDDNNNNNNNNNNNNNNNNNNNNNNNNNNNNNNNNNNNMM:==?~+++?I7?NNNNNNNNNNNNNNNNNNNNNNNDDDNN\n\rNDNNNNNNNNNNNNNNNNNNNNNNNNNNNNNNNNNNM~+=====?I??I7IIZNNNNNNNNNNNNNNNNNNNNNNDDNNN\n\rMONNNMNMMMNNNNNNNNNNNNNNNNNNNNNNNNNMI++==+++??===II7ONNNNNNNNNNNNNNNNNNNMDNDDNNN\n\rMNNNNMNMMMMMMMMNNNNNNNNNNNNNNNNNNNND$$?++??=~==II$7ZONNNNNNNNNNNNNNNNNNMMNNDDNNN\n\rMNNNNMNMMMMMMMMNNNNNNNNNNNNNNNNNNNNMOOI7$Z7?I7$7$$$ZONNNNNNNNNNNNNNNNNMMMNNDDNMM\n\rMNNMNNMMMMMMMMMMNNNNNNNNNNNNNNNNNNMMMOOO8OZZ7$ZZOZZO8NNNNNNNNNNNNNNNNMMMMDNDDNMM\n\rMNMMNNMMMMMMMMMMMNNNNNNNNNNNNNNNNNMNMZN88OOO$ZOZ88ODDNNNNNNNNNNNNNNNMMMMMNNDNNMM\n\rMMMMNNMMMMMMMMMMMNNNNNNNNNNNNNNNNNMMMMDO8O8ZOZOZ888NNNNNNNNNNNNNNNNMMMMMMNNNNNMM\n\rMMMMNNMMMMMMMMMMMMMMNNNNNNNNNNNNNNNNMMN88Z88O88O888NNNNNNNNNNNNNNNNNMMMMMNNNNNMM\n\rMMMMMNMNMMMMMMMNNNMNNNNNNNNNNNNNNNNNMMD88O88888D8DDNNNNNNNNNNNNNNNNNNMMMMNNNNNMM\n\rMMMMNNNMNMMMMMMMNNNNNNNNNNNNNNNNNNNNMMNND8888DDDDNNNNNNNNNNNNNNNNNMMMMMMMNNNMNMM\n\rMMMMNNNNNMMMMMMMNNNNNNNNNNNNNNNNNNNNMMNNNDDDDNNNNNNNNNNNNMMMMNNNMMMMMMMMMNNMMMMM\n\rMNNMNDNNNNNMMMNNNMMNNNNNNNNNNNNNNNNNMMNNNDNNDNNNNNNMNNNNNMMMMMMMMMMMMMMMMMNMMMMM\n\rMMNMMNNNNNNNNNNNNMNMMMMMMMNNMONDDNNNMNNNNDNNNNNNMNNMNNNNNNNNNNNNNMMMMMMMNMMMMMMN\n\rMMMMM88DDD888888DNDD88D8D88DND8OOONMMNNNMDNNDNMMMMNMDNDDDDDDDDDDD8MMMMNMMMMMMMMM\n\rMMNMMMMMMMNMMMMMMMMMMMMMMMNMN8O8Z?7$DMMMMNMMMNMMMMMMMNNNMMNMNNNNNNMMNNNNMMMMMMMM\n\rMMMMMMMMMMMMM$78MMND88ODNNMMNNDDNNNNNNNNNNMMMMMMMMNNNNNNDMDD8MNMMMMMNMMMMMMMMMMM\n\rMNMMMMNMMMMMMNMMMMMNNN8D88NNNNMNMMMMMMMMMMMNNMMMMMMMNNNNMNNDNDODNND8DD$8DNNMMMMM\n\rNMMMMMMMMMMMMMNMMMMNMNMMMMMMMMMMMMMMMMMMMMMMNNMMNNMMMMMMM8NNDNMNNNMMNMNNMMMMMMMM\n\rNNMMNMMMMMMMMMMMNNNNNNNNNNNMMMMNMMMMMMMMMMMMMNNNNNNNNNNNNNNNNNNNNDDDNNNNNNNNNNNN\n\rDNNNNNNNNNNNNNNNNNNNNNNNNNNNNDZZZOO88O8888888888D8888888D8DDD8DDDDDDDDDDDDDDDDDD\r\n\r===============================================\n\r";

const u8 AudioTest_gameOfThrones [] = {
// J=105
// Game of Thrones
0x90,79, 0x91,67, 1,15, 0x81, 0,28, 0x91,60, 1,15, 0x81, 0,28, 0x91,63, 0,136, 0x81, 
0,13, 0x91,65, 0,61, 0x80, 0,75, 0x81, 0,13, 0x90,72, 0x91,67, 1,15, 0x81, 0,28, 
0x91,60, 1,15, 0x81, 0,28, 0x91,63, 0,136, 0x81, 0,13, 0x91,65, 0,61, 0x80, 0,75, 
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0x80, 0xf0};
// This score contains 4212 bytes, and 2 tone generators are used.
// 139 notes had to be skipped.

// Playtune bytestream for file "let_her_go.mid" created by MIDITONES V1.6 on Mon Mar 24 13:55:38 2014
// command line: miditonesV1.6.exe -t2 let_her_go 
const u8 AudioTest_letHerGo [] = {
0x90,81, 0,214, 0x80, 0x90,83, 0,214, 0x80, 0x90,81, 0,214, 0x80, 0x90,79, 0,214, 
0x91,60, 0x80, 0x90,74, 0,214, 0x80, 0x90,76, 0,214, 0x80, 0x90,79, 1,172, 0x81, 0x80, 0x90,60, 
0,214, 0x91,76, 1,172, 0x81, 0x91,83, 0,214, 0x80, 0x81, 0x90,60, 3,89, 0x91,81, 0x80, 0x90,62, 
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0x90,47, 0x91,64, 1,172, 0x80, 0x81, 0x90,52, 10,11, 0x80, 0xf0};
// This score contains 2895 bytes, and 2 tone generators are used.
// 4 notes had to be skipped.

// Playtune bytestream for file "let_it_go.mid" created by MIDITONES V1.6 on Mon Mar 24 15:41:21 2014
// command line: miditonesV1.6.exe -t2 let_it_go 
const u8 AudioTest_letItGo [] = {
0x90,79, 0,201, 0x80, 0,22, 0x90,80, 0,201, 0x80, 0,22, 0x90,72, 0,201, 0x80, 0,22, 
0x90,79, 1,146, 0x80, 0,44, 0x90,80, 2,92, 0x80, 0,67, 0x90,79, 0,201, 0x80, 0,22, 
0x90,80, 0,201, 0x80, 0,22, 0x90,72, 0,201, 0x80, 0,22, 0x90,80, 1,146, 0x80, 0,44, 
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0x81, 3,194, 0x91,89, 13,153, 0x80, 0x81, 0xf0};
// This score contains 5731 bytes, and 2 tone generators are used.
// 556 notes had to be skipped.

// Playtune bytestream for file "let_her_go.mid" created by MIDITONES V1.6 on Thu Mar 20 18:22:25 2014
// command line: miditonesV1.6.exe -t2 let_her_go 
const u8 AudioTest_mario [] = {
0x90,50, 0x91,76, 0,95, 0x80, 0x81, 0,47, 0x90,50, 0x91,76, 0,95, 0x80, 0x81, 0,190, 0x90,50, 
0x91,76, 0,95, 0x80, 0x81, 0,190, 0x90,50, 0x91,72, 0,95, 0x80, 0x81, 0,47, 0x90,50, 0x91,76, 
0,93, 0x81, 0,1, 0x80, 0,190, 0x90,79, 0,95, 0x80, 1,220, 0x90,55, 0,95, 0x80, 1,220, 
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0x80, 0x81, 0,190, 0x90,55, 0,95, 0x80, 0,190, 0x90,48, 0,95, 0x80, 0xf0};
// This score contains 2823 bytes, and 2 tone generators are used.
// 182 notes had to be skipped.

/***********************************************************************************************************************
Function Definitions
***********************************************************************************************************************/

/*--------------------------------------------------------------------------------------------------------------------*/
/* Public functions                                                                                                   */
/*--------------------------------------------------------------------------------------------------------------------*/


/*--------------------------------------------------------------------------------------------------------------------*/
/* Protected functions                                                                                                */
/*--------------------------------------------------------------------------------------------------------------------*/

/*----------------------------------------------------------------------------------------------------------------------
Function: AudioTestInitialize

Description:
Initializes the State Machine and its variables.

Requires:
  -

Promises:
  - 
*/
void AudioTestInitialize(void)
{
  u8* pu8Parser;
  u8 au8AudioTestStartupMsg[] = "\n\rMIDI Player\n\rB0: Stop playback / Toggle verbose\n\rB1: Game of Thrones Theme\n\rB2: Let Her Go\n\rB3: Let It Go from Frozen\n\r";
  //NumberToAscii((55*pow(2,(n-21)/12))/2, au8AudioTestStartupMsg);

  /* Starting LEDs */
  LedOn(WHITE);
  LedOff(PURPLE);
  LedOff(ORANGE);
  LedOff(CYAN);
  LedOff(BLUE);
  LedOff(GREEN);
  LedOff(YELLOW);
  LedOff(RED);
  LedOff(LCD_RED);
  LedOff(LCD_GREEN);
  LedOff(LCD_BLUE);
  
  /* Starting point in Song */
  AudioTest_u32Position = 0;
  AudioTest_u32Delay = 0;
  AudioTest_song = NULL;
  
  /* Starting frequencies */
  PWMAudioSetFrequency(AT91C_PWMC_CHID0, 1000);
  PWMAudioSetFrequency(AT91C_PWMC_CHID1, 1100);

  /* Init complete: set function pointer and application flag */
  AudioTest_u32Timeout = G_u32SystemTime1ms;
  pu8Parser = &au8AudioTestStartupMsg[0];
  while(*pu8Parser != NULL)
  {
    /* Attempt to queue the character */
    if( Uart_putc(*pu8Parser) )
    {
      /* Advance only if character has been sent */
      pu8Parser++;
    }
       
    /* Watch for timeout */
    if( IsTimeUp(&AudioTest_u32Timeout, UTEST_INIT_MSG_TIMEOUT) )
    {
      break;
    }
  }
  
  AudioTest_u32Timeout = G_u32SystemTime1ms;
  G_AudioTestStateMachine = AudioTestSM_Idle;

} /* end AudioTestInitialize() */


/*--------------------------------------------------------------------------------------------------------------------*/
/* Private functions                                                                                                  */
/*--------------------------------------------------------------------------------------------------------------------*/

void UartPrint(u8 au8Msg[])
{
  u8* pu8Parser;

  /* Init complete: set function pointer and application flag */
  Print_u32Timeout = G_u32SystemTime1ms;
  pu8Parser = &au8Msg[0];
  while(*pu8Parser != NULL)
  {
    /* Attempt to queue the character */
    if( Uart_putc(*pu8Parser) )
    {
      /* Advance only if character has been sent */
      pu8Parser++;
    }
       
    /* Watch for timeout */
    if( IsTimeUp(&Print_u32Timeout, UTEST_INIT_MSG_TIMEOUT) )
    {
      break;
    }
  }

} /* end UartPrint() */


/***********************************************************************************************************************
State Machine Function Definitions
***********************************************************************************************************************/

/*--------------------------------------------------------------------------------------------------------------------*/
void AudioTestSM_Idle(void)
{
  u16 freq;
  u8 uartTxt [256];
  static bool verbose = FALSE;
    
  if ( IsButtonPressed(BUTTON0) && AudioTest_song != NULL )
  {
    ButtonAcknowledge(BUTTON0);
    AudioTest_song = NULL;
    PWMAudioOff(AT91C_PWMC_CHID0);
    PWMAudioOff(AT91C_PWMC_CHID1);
    AudioTest_u32Position = 0;
    UartPrint ("\n\r======================================\n\r");
    UartPrint ("Playback Stopped");
    UartPrint ("\n\r======================================\n\r");
  }
  if ( IsTimeUp(&AudioTest_u32Timeout, AudioTest_u32Delay) && AudioTest_song != NULL )
  {
    /* Check for buzzer zero set freq flag "0x90" */
    if (AudioTest_song[AudioTest_u32Position] == 0x90)
    {
      freq = (u16)floor( 27.5 * pow(2.0,(float)(AudioTest_song[AudioTest_u32Position+1]-21)/12.0) );
      PWMAudioSetFrequency(AT91C_PWMC_CHID0, freq);
      PWMAudioOn(AT91C_PWMC_CHID0);
      AudioTest_u32Position += 2;
      if (verbose){
        UartPrint ("Buzzer 0 On @ ");
        NumberToAscii(freq, uartTxt);
        UartPrint (uartTxt);
        UartPrint (" Hz | ");
      }
    }
    /* Check for buzzer one set freq flag "0x91" */
    else if (AudioTest_song[AudioTest_u32Position] == 0x91)
    {
      freq = (u16)floor( 27.5 * pow(2.0,(float)(AudioTest_song[AudioTest_u32Position+1]-21)/12.0) );
      PWMAudioSetFrequency(AT91C_PWMC_CHID1, freq);
      PWMAudioOn(AT91C_PWMC_CHID1);
      AudioTest_u32Position += 2;
      if (verbose){
        UartPrint ("Buzzer 1 On @ ");
        NumberToAscii(freq, uartTxt);
        UartPrint (uartTxt);
        UartPrint (" Hz | ");
      }
    }
    /* Check for buzzer zero set stop flag "0x80" */
    else if (AudioTest_song[AudioTest_u32Position] == 0x80)
    { 
      PWMAudioOff(AT91C_PWMC_CHID0);
      AudioTest_u32Position += 1;
      if (verbose){
        UartPrint ("Buzzer 0 Off | ");
      }
    }
    /* Check for buzzer one set stop flag "0x81" */
    else if (AudioTest_song[AudioTest_u32Position] == 0x81)
    {
      PWMAudioOff(AT91C_PWMC_CHID1);
      AudioTest_u32Position += 1;
      if (verbose){
        UartPrint ("Buzzer 1 Off | ");
      }
    }
    /* Check for delay flag "0XXX XXXX" */
    else if ((0x80 & AudioTest_song[AudioTest_u32Position]) == 0)
    {
      AudioTest_u32Timeout = G_u32SystemTime1ms;
      AudioTest_u32Delay = (AudioTest_song[AudioTest_u32Position] << 8) | AudioTest_song[AudioTest_u32Position+1];
      AudioTest_u32Position += 2;
      if (verbose){
        UartPrint ("Delaying for ");
        NumberToAscii(AudioTest_u32Delay, uartTxt);
        UartPrint (uartTxt);
        UartPrint (" ms\n\r");
      }
    }
    /* Check for end flag "0xF0" */
    else if (AudioTest_song[AudioTest_u32Position] == 0xF0)
    {
      AudioTest_song = NULL;
      AudioTest_u32Position = 0;
      UartPrint ("\n\rEnd of Playback\n\r");
      UartPrint ("======================================\n\r");
    }    
  } else if ( AudioTest_song == NULL) 
  {
    /*  Song Playback controls */
    if (WasButtonPressed(BUTTON0) )
    {
      ButtonAcknowledge(BUTTON0);
      
      if(verbose)
      {
        verbose = FALSE;
        UartPrint ("\n\rVerbose mode off\n\r");
      }
      else
      {
        verbose = TRUE;
        UartPrint ("\n\rVerbose mode on\n\r");
      }
    }
    
    
    if (IsButtonPressed(BUTTON1) )
    {
      AudioTest_song = (u8*)AudioTest_gameOfThrones;
      UartPrint ("\n\r======================================\n\r");
      UartPrint ("Playing: Game of Thrones Theme\n\r\n\r");
      UartPrint (au8AudioTest_gameOfThronesArt);
      AudioTest_u32Position = 0;
    }
    else if (IsButtonPressed(BUTTON2) )
    {
      AudioTest_song = (u8*)AudioTest_letHerGo;
      UartPrint ("\n\r======================================\n\r");
      UartPrint ("Playing: Let Her Go by Passenger\n\r\n\r");
      UartPrint (au8AudioTest_passengerArt);
      AudioTest_u32Position = 0;
    }
    else if (IsButtonPressed(BUTTON3) )
    {
      AudioTest_song = (u8*)AudioTest_letItGo;
      UartPrint ("\n\r======================================\n\r");
      UartPrint ("Playing: Let It Go from Frozen\n\r\n\r");
      UartPrint (au8AudioTest_LetItGoArt1);
      UartPrint (au8AudioTest_LetItGoArt2);
      AudioTest_u32Position = 0;
    }
  }
} /* end AudioTestSM_Idle() */


/*--------------------------------------------------------------------------------------------------------------------*/
/* Handle an error */
void AudioTestSM_Error(void)          
{
  G_AudioTestStateMachine = AudioTestSM_Idle;
  
} /* end AudioTestSM_Error() */


/*--------------------------------------------------------------------------------------------------------------------*/
/* End of File                                                                                                        */
/*--------------------------------------------------------------------------------------------------------------------*/
